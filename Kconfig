## Kconfig
```kconfig
# SPDX-License-Identifier: MIT

menu "liboqs Post-Quantum Cryptography"

    config LIBOQS_ENABLED
        bool "Enable liboqs library"
        default y
        help
            Enable the liboqs post-quantum cryptography library.
            Provides Key Encapsulation Mechanisms (KEMs), Digital Signatures,
            and Stateful Signatures.

            This library implements NIST-standardized algorithms (ML-KEM, ML-DSA)
            and other quantum-safe cryptographic algorithms.

    menu "Algorithm Selection"
        depends on LIBOQS_ENABLED

        comment "Key Encapsulation Mechanisms (KEMs)"

        config LIBOQS_ENABLE_KEM_ML_KEM
            bool "Enable ML-KEM (NIST FIPS 203)"
            default y
            help
                Enable ML-KEM (formerly CRYSTALS-Kyber) - NIST standardized KEM.

                ML-KEM is a lattice-based key encapsulation mechanism standardized
                by NIST in FIPS 203. Recommended for most applications.

                Variants: ML-KEM-512, ML-KEM-768, ML-KEM-1024

        config LIBOQS_ENABLE_KEM_BIKE
            bool "Enable BIKE KEM"
            default n
            help
                BIKE (Bit Flipping Key Encapsulation) - Code-based KEM

        config LIBOQS_ENABLE_KEM_FRODOKEM
            bool "Enable FrodoKEM"
            default n
            help
                FrodoKEM - Conservative lattice-based KEM.
                Higher memory requirements than ML-KEM.

        config LIBOQS_ENABLE_KEM_NTRUPRIME
            bool "Enable NTRU Prime"
            default n
            help
                NTRU Prime - Lattice-based KEM family

        config LIBOQS_ENABLE_KEM_CLASSIC_MCELIECE
            bool "Enable Classic McEliece"
            default n
            help
                Classic McEliece - Code-based KEM with very large keys.
                Not recommended for ESP32 due to memory constraints.

        config LIBOQS_ENABLE_KEM_HQC
            bool "Enable HQC"
            default n
            help
                HQC (Hamming Quasi-Cyclic) - Code-based KEM

        config LIBOQS_ENABLE_KEM_KYBER
            bool "Enable Kyber (NIST Round 3)"
            default n
            help
                Original Kyber from NIST Round 3 (pre-standardization).
                Consider using ML-KEM instead for the standardized version.

        config LIBOQS_ENABLE_KEM_NTRU
            bool "Enable NTRU KEM"
            default n
            help
                NTRU - Lattice-based KEM.
                Adds approximately 52 KB to binary size.

        comment "Digital Signature Schemes"

        config LIBOQS_ENABLE_SIG_ML_DSA
            bool "Enable ML-DSA (NIST FIPS 204)"
            default y
            help
                Enable ML-DSA (formerly CRYSTALS-Dilithium) - NIST standardized signature.

                ML-DSA is a lattice-based signature scheme standardized by NIST
                in FIPS 204. Recommended for most applications.

                Variants: ML-DSA-44, ML-DSA-65, ML-DSA-87

        config LIBOQS_ENABLE_SIG_FALCON
            bool "Enable FALCON"
            default y
            help
                FALCON - Lattice-based signature scheme selected for NIST standardization.

                Compact signatures but requires more stack space for key generation.

        config LIBOQS_ENABLE_SIG_SPHINCS
            bool "Enable SPHINCS+"
            default y
            help
                SPHINCS+ - Hash-based signature scheme (basis for SLH-DSA).

                Stateless hash-based signatures with conservative security assumptions.

        config LIBOQS_ENABLE_SIG_MAYO
            bool "Enable MAYO"
            default y
            help
                MAYO - Multivariate signature scheme.

                Note: MAYO-5 variant is disabled to reduce size.

        config LIBOQS_ENABLE_SIG_CROSS
            bool "Enable CROSS"
            default y
            help
                CROSS - Code-based signature scheme.

                Note: Some variants with large stack usage are automatically disabled
                for ESP32 memory constraints.

        config LIBOQS_ENABLE_SIG_UOV
            bool "Enable UOV"
            default n
            help
                UOV (Unbalanced Oil and Vinegar) - Multivariate signature scheme

        config LIBOQS_ENABLE_SIG_SNOVA
            bool "Enable SNOVA"
            default y
            help
                SNOVA - Multivariate signature scheme.

                Note: Large variants are automatically disabled for ESP32.

        config LIBOQS_ENABLE_SIG_SLH_DSA
            bool "Enable SLH-DSA (FIPS 205)"
            default n
            help
                SLH-DSA - Hash-based signature scheme (FIPS 205).

                Standardized hash-based signatures with multiple variants.
                Adds approximately 50 KB to binary size due to Keccak/SHA3.

    endmenu

    menu "Memory Configuration"
        depends on LIBOQS_ENABLED

        config LIBOQS_TASK_STACK_SIZE
            int "Recommended task stack size for crypto operations (bytes)"
            default 16384
            range 4096 131072
            help
                Recommended stack size for tasks performing cryptographic operations.

                - ML-KEM-768: ~8-16 KB
                - ML-DSA-65: ~8-16 KB
                - FALCON-512: ~32-64 KB

                Set your task stack size via CONFIG_ESP_MAIN_TASK_STACK_SIZE
                or when creating FreeRTOS tasks.

        config LIBOQS_HEAP_SIZE_WARNING_KB
            int "Warn if free heap below this threshold (KB)"
            default 50
            range 10 512
            help
                Log a warning during initialization if free heap falls below
                this threshold. Helps detect potential out-of-memory conditions.

        choice LIBOQS_MEMORY_PROFILE
            prompt "Memory profile for algorithm selection"
            default LIBOQS_MEMORY_BALANCED
            help
                Pre-configured memory profiles for different ESP32 variants.
                This is informational - actual algorithm selection is done above.

            config LIBOQS_MEMORY_MINIMAL
                bool "Minimal (for ESP32-C2)"
                help
                    Recommended for ESP32-C2 (~272 KB SRAM):
                    - ML-KEM-512
                    - ML-DSA-44

            config LIBOQS_MEMORY_BALANCED
                bool "Balanced (ESP32/S2/C3)"
                help
                    Recommended for ESP32, ESP32-S2, ESP32-C3 (~320-400 KB SRAM):
                    - ML-KEM-768
                    - ML-DSA-65
                    - FALCON-512
                    - SPHINCS+-128s

            config LIBOQS_MEMORY_FULL
                bool "Full (ESP32-S3/C6/H2/P4)"
                help
                    Recommended for ESP32-S3, C6, H2, P4 (~512 KB SRAM):
                    - All enabled algorithms
                    - PSRAM support recommended
        endchoice

    endmenu

    menu "Advanced Options"
        depends on LIBOQS_ENABLED

        config LIBOQS_AUTO_INIT_RNG
            bool "Automatically initialize RNG callback"
            default y
            help
                Automatically call OQS_randombytes_custom_algorithm() at startup
                using ESP-IDF's hardware RNG (esp_fill_random).

                If disabled, you must manually call esp_liboqs_rng_init() before
                using any liboqs cryptographic operations.

        config LIBOQS_USE_ESP_RANDOM
            bool "Use esp_fill_random() for RNG"
            default y
            depends on LIBOQS_AUTO_INIT_RNG
            help
                Use ESP-IDF's hardware random number generator.

                esp_fill_random() uses the hardware RNG and is cryptographically
                secure. This is the recommended option for production use.

        config LIBOQS_MINIMAL_COMMON
            bool "Minimal common layer (exclude SHA3/fips202 from common)"
            default n
            help
                Exclude SHA3, SHA2, and fips202 from the liboqs common layer to
                reduce binary size. For signature_basic: enable this when you use
                ONLY ML-DSA (with the Kyber backend). ML-DSA uses its own
                fips202_kyber; the common SHA3/fips202 are not needed.
                Do not enable if you also enable FALCON, SPHINCS+, or other
                signature schemes that need the common hash layer.

        config LIBOQS_VERBOSE_LOGGING
            bool "Enable verbose logging"
            default n
            help
                Enable detailed logging of liboqs operations.
                Useful for debugging but increases code size.

        config LIBOQS_ENABLE_FUNCTION_TRACE
            bool "Enable function instrumentation for profiling"
            default n
            help
                Compile liboqs with -finstrument-functions so enter/exit hooks
                (e.g. liboqs_function_trace.c) can log or profile calls.
                Disable for production to improve speed.

    endmenu

    menu "Profiling"
        depends on LIBOQS_ENABLED

        config LIBOQS_ENABLE_PROFILING
            bool "Enable ESP32-specific profiling"
            default n
            help
                Enable ESP32-specific profiling infrastructure for liboqs functions.
                
                When enabled, you can instrument liboqs functions to measure:
                - Call counts
                - Execution time (microseconds)
                - CPU cycles
                - Min/Max/Average execution times
                
                This uses esp_timer for microsecond timing and CPU cycle counters
                when available (Xtensa CCOUNT, RISC-V mcycle).
                
                WARNING: Profiling adds overhead. Disable for production.

        config LIBOQS_PROFILE_MAX_ENTRIES
            int "Maximum number of profiled functions"
            depends on LIBOQS_ENABLE_PROFILING
            default 100
            range 10 500
            help
                Maximum number of unique functions that can be profiled.
                Each entry uses ~72 bytes of RAM.
                
                Default 100 = ~7.2 KB
                
        config LIBOQS_PROFILE_AUTO_INIT
            bool "Automatically initialize profiling"
            depends on LIBOQS_ENABLE_PROFILING
            default y
            help
                Automatically initialize the profiling system at startup.
                If disabled, you must call esp_liboqs_profile_init() manually.

    endmenu

endmenu
```
